/* The internal configuration keeps the secondary slot in RRAM. */

&rram_controller {
	cpuapp_rram: rram@0 {
		reg = <0x0 DT_SIZE_K(2036)>;
		ranges = <0x0 0x0 DT_SIZE_K(2036)>;
	};
};

&py25q128 {
	status = "disabled";
};

/*
 * XIAO nRF54LM20B (Sense) 5-class gesture demo devicetree overlay
 * ----------------------------------------------------------------------------
 *  - imu_vdd (nPM1300 LDO1): regulator-boot-on keeps the IMU rail up during
 *    boot, before sensor init.
 *  - lsm6ds3tr_c: deferred init; the application probes it (device_init())
 *    after the rail is stable, avoiding the "device not ready" failure.
 *  - axon: enable the NPU node for the Edge AI Axon runtime.
 *
 * SPDX-License-Identifier: Apache-2.0
 */

&imu_vdd {
	regulator-boot-on;
};

&lsm6ds3tr_c {
	zephyr,deferred-init;
	status = "okay";
};

&axon {
	status = "okay";
};

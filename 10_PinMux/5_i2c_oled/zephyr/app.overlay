/*
 * XIAO nRF54LM20B -- Pin Multiplexing demo 5: I2C (SSD1306 OLED)
 * ----------------------------------------------------------------------------
 * i2c22 (SDA=P1.3/D4, SCL=P1.7/D5) is already pinned out in the board DTS
 * (default + sleep states), so this overlay only enables it and adds the
 * SSD1306 framebuffer node as the chosen display. The console is NOT
 * touched (output stays on USB CDC).
 *
 * SPDX-License-Identifier: Apache-2.0
 */

/ {
	chosen {
		zephyr,display = &ssd1306_128x64;
	};
};

&i2c22 {
	status = "okay";
	zephyr,concat-buf-size = <2048>;
	ssd1306_128x64: ssd1306@3c {
		/* Zephyr 4.4 binding is "solomon,ssd1306" (NOT ssd1306fb) */
		compatible = "solomon,ssd1306";
		reg = <0x3c>;
		width = <128>;
		height = <64>;
		segment-offset = <0>;
		page-offset = <0>;
		display-offset = <0>;
		multiplex-ratio = <63>;
		segment-remap;
		com-invdir;
		prechargep = <0x22>;
	};
};
